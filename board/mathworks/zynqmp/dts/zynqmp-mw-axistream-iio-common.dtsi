#include "zynqmp-mw-cma.dtsi"
#include "xilinx-mw-axistream-iio-common.dtsi"

&axi4stream_mm2s {
	reg = <0xA0100000 0x1000>;
	dma-channel@0  {
                interrupt-parent = <&DMA_subsystem_axi_intc_0>;
                interrupts = <1 2>;
	};
};
&axi4stream_s2mm {
	reg = <0xA0110000 0x1000>;
	dma-channel@0  {
		interrupts = <0x0 90 0x4>;
	};
};

