## board/mathworks/zynq/defconfig/linaro.defconfig
```kconfig
###########################################
# Linaro Toolchain Options
###########################################
BR2_TOOLCHAIN_EXTERNAL_LINARO_2013_04=y
BR2_TOOLCHAIN_EXTERNAL_PREINSTALLED=y
BR2_TOOLCHAIN_EXTERNAL_PATH="/opt/linaro/aarch64-6.3.1-2017.02"
BR2_ARM_EABIHF=y
```

## board/mathworks/zynqmp/boards/zcu102_debug/defconfig
```kconfig
###########################################
# ZCU102 Options
###########################################
BR2_TARGET_UBOOT_BOARD_DEFCONFIG="xilinx_zynqmp_zcu102_revB"
BR2_PACKAGE_XILINX_BOOTLOADER_UBOOT_TARGET_DIR="board/xilinx/zynqmp/zynqmp-zcu102-revB"
BR2_TOOLCHAIN_EXTERNAL_PATH="/usr/local/gcc-linaro-6.3.1"
```
